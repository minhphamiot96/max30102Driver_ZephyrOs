## exDriver/drivers/sensor/Kconfig
```kconfig
# Copyright (c) 2022 Nordic Semiconductor ASA
# SPDX-License-Identifier: Apache-2.0

if SENSOR
rsource "max30102/Kconfig"
endif # SENSOR
```

## exDriver/dts/bindings/sensor/maxim,max30102.yaml
```yaml
# Copyright (c) 2018, NXP
# SPDX-License-Identifier: Apache-2.0

description: MAX30102 heart rate sensor
compatible: "maxim,max30102"
include: [sensor-device.yaml, i2c-device.yaml]
properties:
  reg:
    required: true

  int-gpios:
    type: phandle-array
    required: false
    description: |
        The alert pin defaults to active low when produced by the
        sensor, and is open-drain.  A pull-up may be appropriate.  The
        property value should ensure the flags properly describe the
        signal that is presented to the driver.
```
